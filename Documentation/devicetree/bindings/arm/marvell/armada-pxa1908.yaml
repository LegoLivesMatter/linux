## Documentation/devicetree/bindings/arm/marvell/armada-pxa1908.yaml
```yaml
# SPDX-License-Identifier: GPL-2.0-or-later
%YAML 1.2
---
$id: http://devicetree.org/schemas/arm/marvell/pxa1908.yaml#
$schema: http://devicetree.org/meta-schemas/core.yaml#

title: Marvell PXA1908 Platforms

maintainers:
  - Duje Mihanović <duje.mihanovic@skole.hr>

properties:
  $nodename:
    const: '/'
  compatible:
    oneOf:
      - items:
          - enum:
              - samsung,coreprimevelte
          - const: marvell,pxa1908

  pxa,rev-id:
    $ref: /schemas/types.yaml#/definitions/uint32-array
    oneOf:
      - items:
          - description: Board ID
          - description: Board revision
    description: |
      Some bootloaders use this property to determine whether the provided dt
      blob is compatible with a specific device. For example, Samsung's S-Boot
      is known to require this property.

additionalProperties: false
```

## Documentation/devicetree/bindings/arm/marvell/marvell,pxa1908.yaml
```yaml
# SPDX-License-Identifier: GPL-2.0-only OR BSD-2-Clause
%YAML 1.2
---
$id: http://devicetree.org/schemas/arm/marvell/marvell,pxa1908.yaml#
$schema: http://devicetree.org/meta-schemas/core.yaml#

title: Marvell PXA1908 Platforms

maintainers:
  - Duje Mihanović <duje.mihanovic@skole.hr>

properties:
  $nodename:
    const: '/'
  compatible:
    oneOf:
      - items:
          - enum:
              - samsung,coreprimevelte
          - const: marvell,pxa1908

additionalProperties: false
```

## Documentation/devicetree/bindings/clock/marvell,pxa1908.yaml
```yaml
# SPDX-License-Identifier: GPL-2.0-or-later
%YAML 1.2
---
$id: http://devicetree.org/schemas/clock/marvell,pxa1908.yaml#
$schema: http://devicetree.org/meta-schemas/core.yaml#

title: Marvell PXA1908 Clock Controllers

maintainers:
  - Duje Mihanović <duje.mihanovic@skole.hr>

description: |
  The PXA1908 clock subsystem generates and supplies clock to various
  controllers within the PXA1908 SoC. The PXA1908 contains contains numerous
  clock controller blocks, with the ones currently supported being APBC, APBCP,
  MPMU and APMU roughly corresponding to internal buses.

  Each clock is assigned an identifier and client nodes use this identifier to
  specify the clock which they consume.

  All these identifiers could be found in <include/dt-bindings/marvell,pxa1908.h>.

properties:
  compatible:
    enum:
      - marvell,pxa1908-apbc
      - marvell,pxa1908-apbcp
      - marvell,pxa1908-mpmu
      - marvell,pxa1908-apmu
  reg:
    maxItems: 1
    description: |
      Physical address of the clock controller and length of the memory mapped
      region.

  '#clock-cells':
    const: 1

required:
  - compatible
  - reg
  - '#clock-cells'

additionalProperties: false

examples:
  # APMU block:
  - |
    clock-controller@d4282800 {
      compatible = "marvell,pxa1908-apmu";
      reg = <0xd4282800 0x400>;
      #clock-cells = <1>;
    };
```

## Documentation/devicetree/bindings/dma/marvell,mmp-dma.yaml
```yaml
# SPDX-License-Identifier: (GPL-2.0-only OR BSD-2-Clause)
%YAML 1.2
---
$id: http://devicetree.org/schemas/dma/marvell,mmp-dma.yaml#
$schema: http://devicetree.org/meta-schemas/core.yaml#

title: Marvell MMP DMA controller

maintainers:
  - Duje Mihanović <duje.mihanovic@skole.hr>

description:
  Marvell MMP SoCs may have two types of DMA controllers, peripheral and audio.

properties:
  compatible:
    enum:
      - marvell,pdma-1.0
      - marvell,adma-1.0
      - marvell,pxa910-squ

  reg:
    maxItems: 1

  interrupts:
    description:
      Interrupt lines for the controller, may be shared or one per DMA channel
    minItems: 1

  '#dma-channels':
    deprecated: true

  '#dma-requests':
    deprecated: true

required:
  - compatible
  - reg
  - interrupts
  - '#dma-cells'

allOf:
  - $ref: dma-controller.yaml#
  - if:
      properties:
        compatible:
          contains:
            enum:
              - marvell,adma-1.0
              - marvell,pxa910-squ
    then:
      properties:
        asram:
          description:
            phandle to the SRAM pool
          minItems: 1
          maxItems: 1
        iram:
          maxItems: 1

unevaluatedProperties: false

examples:
  # Peripheral controller
  - |
    pdma0: dma-controller@d4000000 {
        compatible = "marvell,pdma-1.0";
        reg = <0xd4000000 0x10000>;
        interrupts = <47>;
        #dma-cells = <2>;
        dma-channels = <16>;
    };

  # Audio controller
  - |
    squ: dma-controller@d42a0800 {
        compatible = "marvell,pxa910-squ";
        reg = <0xd42a0800 0x100>;
        interrupts = <46>;
        #dma-cells = <2>;
        dma-channels = <2>;
    };
```

## Documentation/devicetree/bindings/input/marvell,88pm88x-onkey.yaml
```yaml
# SPDX-License-Identifier: (GPL-2.0-only OR BSD-2-Clause)
%YAML 1.2
---
$id: http://devicetree.org/schemas/input/marvell,88pm88x-onkey.yaml#
$schema: http://devicetree.org/meta-schemas/core.yaml#

title: Onkey driver for Marvell 88PM88X PMICs.

maintainers:
  - Karel Balej <balejk@matfyz.cz>

description: |
  This module is part of the 88PM88X MFD device. For more details
  see Documentation/devicetree/bindings/mfd/marvell,88pm88x.yaml.

  The onkey controller is represented as a sub-node of the PMIC node in
  the device tree.

allOf:
  - $ref: input.yaml#

properties:
  compatible:
    const: marvell,88pm88x-onkey

required:
  - compatible

additionalProperties: false
...
```

## Documentation/devicetree/bindings/mfd/marvell,88pm88x.yaml
```yaml
# SPDX-License-Identifier: (GPL-2.0-only OR BSD-2-Clause)
%YAML 1.2
---
$id: http://devicetree.org/schemas/mfd/marvell,88pm88x.yaml#
$schema: http://devicetree.org/meta-schemas/core.yaml#

title: Marvell 88PM88X PMIC core MFD

maintainers:
  - Karel Balej <balejk@matfyz.cz>

description: |
  Marvell 88PM880 and 88PM886 are two similar PMICs providing
  several functions such as onkey, regulators or battery and
  charger. Both seem to come in two revisions -- A0 and A1.

properties:
  compatible:
    const: marvell,88pm886-a1

  reg:
    description: I2C device address
    maxItems: 1

  interrupt-controller: true

  interrupts:
    maxItems: 1

  "#interrupt-cells":
    const: 2

required:
  - compatible
  - reg
  - interrupt-controller
  - interrupts

additionalProperties: false

examples:
  - |
    i2c {
      #address-cells = <1>;
      #size-cells = <0>;
      pmic0: 88pm886@30 {
        compatible = "marvell,88pm886-a1";
        reg = <0x30>;
        interrupts = <0 4 IRQ_TYPE_LEVEL_HIGH>;
        interrupt-parent = <&gic>;
        interrupt-controller;
        #interrupt-cells = <1>;
      };
    };
...
```

## arch/arm/mach-scx35/Kconfig
```kconfig
menuconfig ARCH_SCX35
	bool "Spreadtrum SCX35 Support"
	depends on ARCH_MULTI_V7
	select SCX35_TIMER
	help
		Support for the Spreadtrum SCxx30 family of SoCs.
```

## drivers/marvell/Kconfig
```kconfig
menuconfig MARVELL_DRIVERS
	bool "Marvell kernel module drivers"
	help
	  marvell kernel module drivers

if MARVELL_DRIVERS

config MRVL_RSV_PAGE
	tristate "Marvell emmc reserve page"
	default y
	help
	Reserve some range both in eMMC and DDR memory.
	With the help of bootloader, Driver or module can use
	the data before eMMC is ready. It is something like DTB.

endif
```
